## conf/layer.conf
```bitbake
# We have a conf and classes directory, append to BBPATH
BBPATH .= ":${LAYERDIR}"

# We have recipes-* directories, add to BBFILES
BBFILES += "${LAYERDIR}/recipes-*/*/*.bb \
            ${LAYERDIR}/recipes-*/*/*.bbappend"

BBFILE_COLLECTIONS += "meta-seacloud-bsp"
BBFILE_PATTERN_meta-seacloud-bsp := "^${LAYERDIR}/"
BBFILE_PRIORITY_meta-seacloud-bsp = "92"
LAYERVERSION_meta-seacloud-bsp = "1"

LAYERSERIES_COMPAT_meta-seacloud-bsp = "sumo thud warrior"
```

## conf/machine/colibri-imx7-emmc-1370.conf
```bitbake
#@TYPE: Machine
#@NAME: Toradex Colibri iMX7 Dual 1GB (eMMC)
#@SOC: i.MX 7Dual
#@DESCRIPTION: Machine configuration for Toradex Colibri iMX7 SOM
#@MAINTAINER: Stefan Agner <stefan.agner@toradex.com>

MACHINEOVERRIDES =. "mx7:mx7d:"

include conf/machine/include/imx-base.inc
include conf/machine/include/tune-cortexa7.inc

PREFERRED_PROVIDER_virtual/kernel ?= "linux-toradex"
KERNEL_IMAGETYPE = "zImage"
KERNEL_DEVICETREE += " \
    imx7d-colibri-emmc-eval-v3.dtb \
    imx7d-colibri-emmc-aster.dtb \
    imx7d-colibri-emmc-1370.dtb \
"

# The kernel lives in a seperate FAT partition, don't deploy it in /boot/
RDEPENDS_${KERNEL_PACKAGE_NAME}-base = ""

PREFERRED_PROVIDER_u-boot = "u-boot-toradex"
PREFERRED_PROVIDER_virtual/bootloader = "u-boot-toradex"
PREFERRED_PROVIDER_u-boot-fw-utils = "u-boot-toradex-fw-utils"
UBOOT_MACHINE = "colibri_imx7_emmc_defconfig"

IMAGE_FSTYPES += " \
    wic.gz \
    tar.xz \
"

# wic support
WKS_FILE = "sdimage-bootpart.wks"
WIC_CREATE_EXTRA_ARGS_append = " --no-fstab-update"

SERIAL_CONSOLES = "115200;ttymxc0"

#MACHINE_FEATURES += "screen usbgadget usbhost vfat ext2 alsa touchscreen wifi bluetooth 3g"
MACHINE_FEATURES += " \
    screen \
    usbhost \
    vfat \
    ext2 \
    touchscreen \
    wifi \
    3g \
"
```

## conf/machine/include/colibri-imx7-emmc-1370.inc
```bitbake
IMAGE_CLASSES += "image_type_tezi"
IMAGE_FSTYPES_append = " teziimg"
IMAGE_CLASSES += "image_type_swuimage"
IMAGE_FSTYPES_append = " swuimage"
# The payload offsets are given in number of 512 byte blocks.
OFFSET_BOOTROM_PAYLOAD = "2"
TORADEX_PRODUCT_IDS = "0039"
TORADEX_FLASH_TYPE = "emmc"

MACHINE_NAME = "Colibri-iMX7-eMMC"

MACHINE_BOOT_FILES = "boot.scr"
IMAGE_BOOT_FILES_append = " ${MACHINE_BOOT_FILES}"
WKS_FILE_DEPENDS_append = " u-boot-distro-boot"

MACHINE_FIRMWARE_remove = "firmware-imx-epdc"

# Use i.MX Gstreamer Version (for PXP DMA-ENGINE Driver)
#
# not verified for updated version since eagle BSP upgrade
# please verify before including into image
#
PREFERRED_VERSION_gstreamer1.0 = "1.14.imx"
PREFERRED_VERSION_gstreamer1.0-plugins-base = "1.14.imx"
PREFERRED_VERSION_gstreamer1.0-plugins-good = "1.14.imx"
PREFERRED_VERSION_gstreamer1.0-plugins-bad = "1.14.imx"
```
